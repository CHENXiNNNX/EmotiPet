## main/Kconfig.projbuild
```kconfig
menu "EmotiPet Assets 配置"

    config ENABLE_ASSETS_BUILD
        bool "启用 Assets 构建"
        default n
        help
            启用从 ESP-SR 模型自动构建 assets.bin。
            如果禁用，将不会自动构建 assets.bin。

    if ENABLE_ASSETS_BUILD
        config ASSETS_MODELS
            string "模型列表（支持多种类型）"
            default "vadnet1_medium nsnet1"
            help
                要包含在 assets.bin 中的模型名称列表（空格分隔）。
                支持自动识别模型类型：
                - WakeNet: wn9_*, wn8_* (唤醒词检测)
                - VADNet: vadnet* (语音活动检测，用于 AFE)
                - NSNet: nsnet* (噪声抑制，用于 AFE)
                - MultiNet: mn*_cn, mn*_en (语音命令识别)
                
                示例:
                - "vadnet1_medium nsnet1" (用于 AFE)
                - "mn6_cn mn6_en" (用于语音命令识别)
                - "vadnet1_medium nsnet1 mn6_cn" (混合使用)

        config ASSETS_CN_WAKE_WORD
            string "中文唤醒词"
            default ""
            help
                中文唤醒词命令（拼音格式，例如: "ni hao xiao zhi"）。
                留空以禁用默认中文唤醒词。
                唤醒词可以在运行时动态添加。

        config ASSETS_EN_WAKE_WORD
            string "英文唤醒词"
            default ""
            help
                英文唤醒词命令（例如: "hello"）。
                留空以禁用默认英文唤醒词。
                唤醒词可以在运行时动态添加。

        config ASSETS_WAKE_WORD_THRESHOLD
            string "唤醒词检测阈值"
            default "0.2"
            help
                唤醒词检测阈值（0.0 到 1.0，字符串格式）。
                值越小 = 越敏感，值越大 = 越不敏感。
                示例: "0.2" 或 "0.15"
    endif

endmenu
```

## sdkconfig.defaults
```kconfig
CONFIG_ESPTOOLPY_FLASHSIZE_16MB=y
CONFIG_ESPTOOLPY_FLASHMODE_QIO=y
CONFIG_ESPTOOLPY_BAUD_2000000B=y
CONFIG_ESPTOOLPY_BAUD=2000000

CONFIG_ESP_DEFAULT_CPU_FREQ_MHZ_240=y

CONFIG_SPIRAM=y
CONFIG_SPIRAM_MODE_OCT=y
CONFIG_SPIRAM_SPEED_80M=y
CONFIG_SPIRAM_MALLOC_ALWAYSINTERNAL=512
CONFIG_SPIRAM_MALLOC_RESERVE_INTERNAL=65536
CONFIG_SPIRAM_MEMTEST=n
CONFIG_MBEDTLS_EXTERNAL_MEM_ALLOC=y

CONFIG_COMPILER_OPTIMIZATION_SIZE=y 
CONFIG_COMPILER_CXX_EXCEPTIONS=y
CONFIG_COMPILER_CXX_EXCEPTIONS_EMG_POOL_SIZE=1024
CONFIG_COMPILER_CXX_RTTI=y

CONFIG_BOOTLOADER_COMPILER_OPTIMIZATION_PERF=y
CONFIG_BOOTLOADER_LOG_LEVEL_NONE=y
CONFIG_BOOTLOADER_SKIP_VALIDATE_ALWAYS=y
CONFIG_BOOTLOADER_APP_ROLLBACK_ENABLE=y

CONFIG_HTTPD_MAX_REQ_HDR_LEN=2048
CONFIG_HTTPD_MAX_URI_LEN=2048

CONFIG_PARTITION_TABLE_CUSTOM=y
CONFIG_PARTITION_TABLE_CUSTOM_FILENAME="partition.csv"
CONFIG_PARTITION_TABLE_OFFSET=0x8000

CONFIG_ESP_TASK_WDT_TIMEOUT_S=10
CONFIG_FREERTOS_GENERATE_RUN_TIME_STATS=y
CONFIG_FREERTOS_USE_STATS_FORMATTING_FUNCTIONS=y

CONFIG_ESP_MAIN_TASK_STACK_SIZE=30000
CONFIG_MBEDTLS_DYNAMIC_BUFFER=y
CONFIG_MBEDTLS_SSL_KEEP_PEER_CERTIFICATE=n
CONFIG_ESP_WIFI_IRAM_OPT=n
CONFIG_ESP_WIFI_RX_IRAM_OPT=n
CONFIG_ESP_WIFI_DYNAMIC_RX_MGMT_BUFFER=y

CONFIG_ESP_WIFI_STATIC_RX_BUFFER_NUM=3
CONFIG_ESP_WIFI_DYNAMIC_RX_BUFFER_NUM=6
CONFIG_ESP_WIFI_RX_BA_WIN=3
CONFIG_LWIP_TCPIP_RECVMBOX_SIZE=16
CONFIG_MBEDTLS_DYNAMIC_FREE_CONFIG_DATA=y
CONFIG_NEWLIB_NANO_FORMAT=y

CONFIG_ESP32S3_INSTRUCTION_CACHE_32KB=y
CONFIG_ESP32S3_DATA_CACHE_LINE_64B=y

CONFIG_SR_WN_WN9_NIHAOXIAOZHI_TTS=y

CONFIG_ESP_SYSTEM_EVENT_TASK_STACK_SIZE=4096

CONFIG_CODEC_I2C_BACKWARD_COMPATIBLE=n

CONFIG_MBEDTLS_SSL_RENEGOTIATION=n

# Bluetooth Configuration
CONFIG_BT_ENABLED=y
CONFIG_BT_NIMBLE_ENABLED=y
CONFIG_BT_CONTROLLER_ENABLED=y
CONFIG_BT_CONTROLLER_BLE_MAX_CONN=3
CONFIG_BT_CONTROLLER_BLE_MAX_CONN_EFF=3
CONFIG_BT_NIMBLE_MAX_CONNECTIONS=3
CONFIG_BT_NIMBLE_ROLE_PERIPHERAL=y
CONFIG_BT_NIMBLE_ROLE_BROADCASTER=y
CONFIG_BT_NIMBLE_ROLE_CENTRAL=y
CONFIG_BT_NIMBLE_ROLE_OBSERVER=y
CONFIG_BT_NIMBLE_EXT_ADV=n
CONFIG_BT_NIMBLE_MAX_BONDS=3
CONFIG_BT_NIMBLE_PINNED_TO_CORE_0=y
CONFIG_BT_NIMBLE_TASK_STACK_SIZE=4096
CONFIG_BT_NIMBLE_MEM_ALLOC_MODE_INTERNAL=y
CONFIG_BT_NIMBLE_LOG_LEVEL=3

# Camera Configuration
CONFIG_ESP_VIDEO_ENABLE_DVP_VIDEO_DEVICE=y
CONFIG_CAMERA_OV3660=y                                             
CONFIG_CAMERA_OV3660_AUTO_DETECT_DVP_INTERFACE_SENSOR=y           
CONFIG_CAMERA_OV3660_DVP_YU422_240X240_24FPS=y                     
CONFIG_XIAOZHI_ENABLE_CAMERA_ENDIANNESS_SWAP=y
```

## third_party/nopnop2002__mpr121/Kconfig.projbuild
```kconfig
menu "MPR121 Configuration"
	visible if 0  # 隐藏菜单，配置在代码中定义

	config GPIO_RANGE_MAX
		int
		default 33 if IDF_TARGET_ESP32
		default 46 if IDF_TARGET_ESP32S2
		default 48 if IDF_TARGET_ESP32S3
		default 18 if IDF_TARGET_ESP32C2
		default 19 if IDF_TARGET_ESP32C3
		default 30 if IDF_TARGET_ESP32C6

	choice I2C_PORT
		prompt "I2C port that controls this bus"
		default I2C_PORT_1
		help
			Select I2C port that controls this bus.
		config I2C_PORT_0
			bool "I2C_PORT_0"
			help
				Use I2C_PORT_0.
		config I2C_PORT_1
			bool "I2C_PORT_1"
			help
				Use I2C_PORT_1.
	endchoice

	config LEGACY_DRIVER
		bool "Force legacy i2c driver"
		default false
		help
			Force legacy i2c driver.

	config I2C_ADDRESS
		hex "I2C address"
		default 0x5A
		help
			I2C address.

	config SCL_GPIO
		int "SCL GPIO number"
		range 0 GPIO_RANGE_MAX
		default 18
		help
			GPIO number (IOxx) to SCL.
			Some GPIOs are used for other purposes (flash connections, etc.) and cannot be used to blink.

	config SDA_GPIO
		int "SDA GPIO number"
		range 0 GPIO_RANGE_MAX
		default 17
		help
			GPIO number (IOxx) to SDA.
			Some GPIOs are used for other purposes (flash connections, etc.) and cannot be used to blink.

	config IRQ_GPIO
		int "IRQ GPIO number"
		range 0 GPIO_RANGE_MAX
		default 0
		help
			GPIO number (IOxx) to IRQ.
			Some GPIOs are used for other purposes (flash connections, etc.) and cannot be used to blink.

endmenu
```
